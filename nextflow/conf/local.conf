## nextflow/conf/local.conf
```bitbake
///////////
// CONDA //
///////////

//def denovowestEnvLocation = "../misc/conda/denovowest.yml"
// If the conda environments was installed outside of nextflow, you can also provide its path directly
def denovowestEnvLocation = "/software/hgi/envs/conda/team29/ed11/denovowest"

///////////////
// CONTAINER //
///////////////

// TODO : Some processes (e.g. RATE_STATS) fail because their script is not accessible in the container
// if I do not include the following lines. There is likely a better way to do this 
nextflowDir = "$PWD"
nextflowCanonicalDir = new File(nextflowDir).canonicalPath
dnwDir = new File(nextflowCanonicalDir).parent

singularity {
    runOptions = "--bind " + dnwDir
}

// TODO : Had to add the path to the python binary on the container. 
docker {
    runOptions = "-e PATH=$PATH:/opt/view/bin -v " + dnwDir + ":" + dnwDir
}

/////////////
// PROCESS //
/////////////

process {
    conda = denovowestEnvLocation
}

executor {

  retry {
      max = 1
  }
  errorStrategy = 'ignore'
}
```
